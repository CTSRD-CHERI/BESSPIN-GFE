#if CPU_SPEED == 0
#if __riscv_xlen == 32
#define CPU_SPEED 50000000
#else
#define CPU_SPEED 100000000
#endif
#endif

#if RTC_FREQ == 0
#define RTC_FREQ CPU_SPEED
#endif

#if __riscv_xlen == 32
#define _CPU_RISCV_ISA riscv,isa = "rv32imac";
#define _CPU_MMU_TYPE
#elif __riscv_xlen == 64
#define _CPU_RISCV_ISA riscv,isa = "rv64imafdc";
#define _CPU_MMU_TYPE mmu-type = "riscv,sv39";
#else
#error "Unsupported XLEN"
#endif

#define _MAX_SUPPORTED_CORES 4
#if NUM_CORES > _MAX_SUPPORTED_CORES
#error "More cores requested than currently supported."
#endif

#define _DECLARE_CPU(_n) \
	CPU##_n: cpu@##_n { \
		device_type = "cpu"; \
		reg = <_n>; \
		status = "okay"; \
		compatible = "riscv"; \
		_CPU_RISCV_ISA \
		_CPU_MMU_TYPE \
		clock-frequency = <CPU_SPEED>; \
		sri-cambridge,version = PROC_HASH; \
		CPU##_n##_intc: interrupt-controller { \
			#interrupt-cells = <1>; \
			interrupt-controller; \
			compatible = "riscv,cpu-intc"; \
		}; \
	};

#define _DECLARE_CPU_CLINT(_n) &CPU##_n##_intc 3 &CPU##_n##_intc 7

#define _DECLARE_CPU_PLIC(_n) &CPU##_n##_intc 11 &CPU##_n##_intc 9

/dts-v1/;

/ {
	#address-cells = <1>;
	#size-cells = <1>;
	compatible = "unknown,unknown";
	model = "unknown,unknown";
	sri-cambridge,version = GFE_HASH; \
	chosen {
		bootargs = "earlyprintk console=ttyS0,115200 loglevel=15";
		stdout-path = &ns16550;
	};
	cpus {
		#address-cells = <1>;
		#size-cells = <0>;
		timebase-frequency = <RTC_FREQ>;
		_DECLARE_CPU(0)
#if NUM_CORES > 1
		_DECLARE_CPU(1)
#endif
#if NUM_CORES > 2
		_DECLARE_CPU(2)
#endif
#if NUM_CORES > 3
		_DECLARE_CPU(3)
#endif
	};
	memory {
		device_type = "memory";
		reg = <0xC0000000 MEM_SIZE>;
	};
	reserved-memory {
		#address-cells = <1>;
		#size-cells = <1>;
		ranges;

		reserved: ethernet@62100000 {
			compatible = "shared-dma-pool";
			no-map;
			reg = <0x80000000 0x20000000>;
		};
		linux,dma {
			compatible = "shared-dma-pool";
			reg = <0xa0000000 0x20000000>;
			linux,dma-default;
			no-map;
		};
	};
	soc {
		#address-cells = <1>;
		#size-cells = <1>;
		compatible = "simple-bus";
		ranges;
		clint@10000000 {
			compatible = "riscv,clint0";
			interrupts-extended = <
				_DECLARE_CPU_CLINT(0)
#if NUM_CORES > 1
				_DECLARE_CPU_CLINT(1)
#endif
#if NUM_CORES > 2
				_DECLARE_CPU_CLINT(2)
#endif
#if NUM_CORES > 3
				_DECLARE_CPU_CLINT(3)
#endif
				>;
			reg = <0x10000000 0x10000>;
		};
		plic: interrupt-controller@c000000 {
			#interrupt-cells = <1>;
			compatible = "riscv,plic0";
			interrupt-controller;
			interrupts-extended = <
				_DECLARE_CPU_PLIC(0)
#if NUM_CORES > 1
				_DECLARE_CPU_PLIC(1)
#endif
#if NUM_CORES > 2
				_DECLARE_CPU_PLIC(2)
#endif
#if NUM_CORES > 3
				_DECLARE_CPU_PLIC(3)
#endif
				>;
			reg = <0xc000000 0x400000>;
			reg-names = "control";
			riscv,max-priority = <7>;
			riscv,ndev = <16>;
		};
		axi_ethernet_eth: ethernet@62100000 {
			compatible = "xlnx,axi-ethernet-7.01.a", "xlnx,axi-ethernet-1.00.a";
			memory-region = <&reserved>;
			device_type = "network";
			interrupts-extended = <&plic 2>;
			axistream-connected = <&axi_dma>;
			axistream-connected-control = <&axi_dma>;
			phy-mode = "sgmii";
			reg = <0x62100000 0x40000>;
			xlnx,rxcsum = <0x2>;
			xlnx,rxmem = <0x1000>;
			xlnx,txcsum = <0x2>;
			xlnx,phy-type = <0x4>;
			phy-handle = <&phy0>;
			xlnx,vcu118;
			local-mac-address = [00 0a 35 04 db 5a];
			clock-frequency = <CPU_SPEED>;
			axi_ethernet_mdio: mdio {
				#address-cells = <1>;
				#size-cells = <0>;
				phy0: phy@3 {
				      device_type = "ethernet-phy";
				      ti,fifo-depth = <1>;
				      reg = <3>;
				};
			};
		};
		axi_dma: dma@62200000 {
			#dma-cells = <1>;
			compatible = "xlnx,eth-dma";
			reg = <0x62200000 0x10000>;
			interrupts-extended = <&plic 3 &plic 4>;
			axistream-connected = <&axi_ethernet_eth>;
			axistream-connected-control = <&axi_ethernet_eth>;
		};
		ns16550: uart@62300000 {
			current-speed = <115200>;
			compatible = "ns16550a";
			interrupts-extended = <&plic 1>;
			reg = <0x62300000 0x1000>;
			clock-frequency = <CPU_SPEED>;
			reg-shift = <2>;
		};
#if NO_PCI == 0
		pci: pci@20000000 {
		     #address-cells = <3>;
		     #size-cells = <2>;
		     #interrupt-cells = <1>;
		     compatible = "xlnx,xdma-host-3.00";
		     device_type = "pci";
		     interrupt-names = "misc", "msi0", "msi1";
		     interrupt-map-mask = <0 0 0 7>;
		     interrupt-map = <0 0 0 1 &pcie_intc_0 1>, <0 0 0 2 &pcie_intc_0 2>, <0 0 0 3 &pcie_intc_0 3>, <0 0 0 4 &pcie_intc_0 4>;
		     interrupts-extended = <&plic 9>, <&plic 10>, <&plic 11>;
		     ranges = <0x02000000 0x0 0x30000000  0x30000000  0x0 0x10000000>;
		     reg = <0x20000000 0x10000000>;
		     pcie_intc_0: interrupt-controller {
			 interrupt-controller;
			 #address-cells = <0>;
			 #interrupt-cells = <1>;
		     };
		};
#endif
	};
};
